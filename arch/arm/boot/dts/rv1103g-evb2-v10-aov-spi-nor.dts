// SPDX-License-Identifier: (GPL-2.0+ OR MIT)
/*
 * Copyright (c) 2023 Rockchip Electronics Co., Ltd.
 */

/dts-v1/;

#include "rv1103g-evb2-v10.dts"

/ {
	model = "Rockchip RV1103G EVB2 V12 Board";
	compatible = "rockchip,rv1103g-evb2-v10-aov", "rockchip,rv1103";
};

&rkcif_mipi_lvds {
	status = "okay";
	aov-reserved;
};
